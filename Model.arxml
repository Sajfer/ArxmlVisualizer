AUTOSAR XML (schema 4-3-0)
package /test
  complex device driver sw component type TestComponent
    behavior TestComponentBehavior: handle-termination-and-restart=NO-SUPPORT
      timing event TestComponentMainLoop: start-on-event=TestComponent, period=0.01
      runnable TestComponent
  swc implementation TestComponentImpl: programming-language=C, vendor-id=0
    code-descriptors:
      code src: artifact-descriptors=autosar-engineering-object={short-label=artifactDescriptor, category=artifactDescriptorCategory}
    resource consumption resourceConsumption
  composition sw component type TestComposition1
    component TestProt1: type=TestComponent
  composition sw component type TestComposition2
    component TestProt2: type=TestComponent
